## main/Kconfig.projbuild
```kconfig
menu "Electronic badge"
    config BAJI_BOARD_CHECK
        bool "Run the G1 hardware check at startup"
        default n
        help
            Show color bars, touch coordinates and power readings in place
            of the interactive pixel pet.
endmenu
```

## sdkconfig.defaults
```kconfig
# Waveshare ESP32-S3-Touch-AMOLED-1.75C / ESP-IDF 5.5.4
CONFIG_IDF_TARGET="esp32s3"
CONFIG_ESPTOOLPY_FLASHMODE_QIO=y
CONFIG_ESPTOOLPY_FLASHSIZE_32MB=y
CONFIG_SPIRAM=y
CONFIG_SPIRAM_MODE_OCT=y
CONFIG_SPIRAM_SPEED_80M=y
CONFIG_ESP_DEFAULT_CPU_FREQ_MHZ_240=y
CONFIG_COMPILER_OPTIMIZATION_PERF=y
CONFIG_FREERTOS_HZ=1000
CONFIG_SPI_MASTER_IN_IRAM=y
CONFIG_ESP_CONSOLE_USB_SERIAL_JTAG=y
```
